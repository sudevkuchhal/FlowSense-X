#include "rpm_sensor.h"

#include <Arduino.h>

#include "pins.h"
#include "constants.h"

// ==========================================================
// FlowSense-X
// IR Reflective RPM Sensor
// ==========================================================
//
// IMPORTANT:
//
// This module is ONLY an RPM measurement system.
//
// IR detection does NOT:
//   - stop the motor
//   - reduce throttle
//   - trigger emergency stop
//   - change ESC PWM
//
// It only counts pulses generated by the black mark.
//
// ==========================================================

namespace
{
    // ------------------------------------------------------
    // Sensor configuration
    // ------------------------------------------------------

    constexpr uint8_t IR_ACTIVE_STATE = LOW;

    // One black mark on the shaft:
    // 1 pulse = 1 revolution
    constexpr uint16_t PULSES_PER_REV = 1;

    // ------------------------------------------------------
    // Measurement window
    // ------------------------------------------------------

    constexpr uint32_t RPM_MEASUREMENT_INTERVAL_MS = 100;

    constexpr uint32_t RPM_SIGNAL_TIMEOUT_MS = 500;

    // ------------------------------------------------------
    // Pulse filtering
    // ------------------------------------------------------

    constexpr uint32_t MIN_PULSE_INTERVAL_US = 1000;

    // ------------------------------------------------------
    // ISR variables
    // ------------------------------------------------------

    volatile uint32_t pulseCountISR = 0;

    volatile uint32_t lastPulseUsISR = 0;
    volatile uint32_t pulsePeriodUsISR = 0;

    // ------------------------------------------------------
    // Calculated values
    // ------------------------------------------------------

    float currentRpm = 0.0f;

    uint32_t totalPulseCount = 0;

    uint32_t pulsesPerSecond = 0;

    uint32_t lastMeasurementMs = 0;

    uint32_t lastValidPulseUs = 0;

    bool initialized = false;

    bool valid = false;

    bool signalPresent = false;

    // ======================================================
    // IR INTERRUPT
    // ======================================================

    void IRAM_ATTR rpmPulseISR()
    {
        const uint32_t nowUs = micros();

        // --------------------------------------------------
        // Noise / duplicate pulse rejection
        // --------------------------------------------------

        if (
            lastPulseUsISR != 0 &&
            (nowUs - lastPulseUsISR) < MIN_PULSE_INTERVAL_US
        )
        {
            return;
        }

            if (lastPulseUsISR != 0)
        {
            pulsePeriodUsISR = nowUs - lastPulseUsISR;
        }

        lastPulseUsISR = nowUs;
        ++pulseCountISR;
    }
}

// ==========================================================
// INITIALIZATION
// ==========================================================

bool rpmSensorInit()
{
    // ------------------------------------------------------
    // Reset state
    // ------------------------------------------------------

    noInterrupts();

    pulseCountISR = 0;
    lastPulseUsISR = 0;
    pulsePeriodUsISR = 0;

    interrupts();

    currentRpm = 0.0f;

    totalPulseCount = 0;

    pulsesPerSecond = 0;

    lastMeasurementMs = millis();

    lastValidPulseUs = 0;

    valid = false;

    signalPresent = false;

    // ------------------------------------------------------
    // IR sensor input
    // ------------------------------------------------------

    pinMode(
        PIN_IR_RPM_SENSOR,
        INPUT
    );

    // ------------------------------------------------------
    // Interrupt
    // ------------------------------------------------------
    //
    // GPIO33 -> IR sensor OUT
    //
    // FALLING:
    // HIGH -> LOW = detection
    //
    // ------------------------------------------------------

    attachInterrupt(
        digitalPinToInterrupt(
            PIN_IR_RPM_SENSOR
        ),
        rpmPulseISR,
        FALLING
    );

    initialized = true;

    valid = true;

    return true;
}

// ==========================================================
// UPDATE RPM
// ==========================================================

void rpmSensorUpdate()
{
    if (!initialized)
    {
        currentRpm = 0.0f;

        pulsesPerSecond = 0;

        signalPresent = false;

        valid = false;

        return;
    }

    const uint32_t nowMs = millis();

    // ------------------------------------------------------
    // Check measurement interval
    // ------------------------------------------------------

    if (
        nowMs - lastMeasurementMs <
        RPM_MEASUREMENT_INTERVAL_MS
    )
    {
        return;
    }

    const uint32_t elapsedMs =
        nowMs - lastMeasurementMs;

    lastMeasurementMs = nowMs;

    // ------------------------------------------------------
    // Copy ISR pulse counter safely
    // ------------------------------------------------------

    uint32_t currentPulseCount;
    uint32_t lastPulseUs;

    noInterrupts();

    currentPulseCount = pulseCountISR;
    lastPulseUs = lastPulseUsISR;

    interrupts();

    // ------------------------------------------------------
    // Calculate pulses detected during this window
    // ------------------------------------------------------

    const uint32_t previousPulseCount =
        totalPulseCount;

    const uint32_t newPulses =
        currentPulseCount - previousPulseCount;

    totalPulseCount = currentPulseCount;

    // ------------------------------------------------------
    // Pulses per second
    // ------------------------------------------------------

    if (elapsedMs > 0)
    {
        pulsesPerSecond =
            (
                newPulses * 1000UL
            ) / elapsedMs;
    }
    else
    {
        pulsesPerSecond = 0;
    }

    // ------------------------------------------------------
    // RPM calculation from pulse-to-pulse period
    // ------------------------------------------------------
    // RPM = 60,000,000 / period_us / pulses_per_revolution
    // One black mark = one revolution.
    // ------------------------------------------------------

    uint32_t pulsePeriodUs = 0;
    noInterrupts();
    pulsePeriodUs = pulsePeriodUsISR;
    interrupts();

    if (pulsePeriodUs >= MIN_PULSE_INTERVAL_US)
    {
        currentRpm =
            60000000.0f /
            (static_cast<float>(pulsePeriodUs) * static_cast<float>(PULSES_PER_REV));
    }
    else if (newPulses == 0)
    {
        currentRpm = 0.0f;
    }

    // ------------------------------------------------------
    // Signal timeout
    // ------------------------------------------------------

    const uint32_t nowUs = micros();

    if (
        lastPulseUs == 0 ||
        (nowUs - lastPulseUs) >
        (RPM_SIGNAL_TIMEOUT_MS * 1000UL)
    )
    {
        currentRpm = 0.0f;

        signalPresent = false;
    }
    else
    {
        signalPresent = true;
    }

    // ------------------------------------------------------
    // RPM validity
    // ------------------------------------------------------

    valid = true;

    lastValidPulseUs = lastPulseUs;
}

// ==========================================================
// GET RPM
// ==========================================================

float rpmSensorGetRpm()
{
    return currentRpm;
}

// ==========================================================
// GET TOTAL PULSE COUNT
// ==========================================================

uint32_t rpmSensorGetPulseCount()
{
    uint32_t count;

    noInterrupts();

    count = pulseCountISR;

    interrupts();

    return count;
}

// ==========================================================
// GET PULSES / SECOND
// ==========================================================

uint32_t rpmSensorGetPulsesPerSecond()
{
    return pulsesPerSecond;
}

// ==========================================================
// SENSOR VALIDITYD:\.platformio\penv\Scripts\platformio.exe run -t clean
// ==========================================================

bool rpmSensorIsValid()
{
    return valid;
}

// ==========================================================
// SIGNAL STATUS
// ==========================================================

bool rpmSensorSignalPresent()
{
    return signalPresent;
}

// ==========================================================
// COMPLETE STATE
// ==========================================================

RpmSensorState rpmSensorGetState()
{
    return {
        currentRpm,
        rpmSensorGetPulseCount(),
        pulsesPerSecond,
        valid,
        signalPresent
    };
}