#include "events.h"

#include <Arduino.h>

#include "constants.h"

// ==========================================================
// FlowSense-X
// Event / Fault Manager
// ==========================================================
//
// Responsibilities:
//   - Over-current protection
//   - Over-speed protection
//   - Current sensor validation
//   - IR RPM sensor validation
//   - Invalid target protection
//   - Emergency-stop handling
//   - Warning and recovery events
//
// ==========================================================

namespace
{
    EventStatus status{
        FaultCode::None,
        EventType::None,
        false,
        0,
        0
    };

    // ------------------------------------------------------
    // Set event
    // ------------------------------------------------------

    void setEvent(
        FaultCode fault,
        EventType type
    )
    {
        const bool changed =
            status.fault != fault ||
            status.type != type ||
            !status.active;

        status.fault = fault;
        status.type = type;
        status.active = true;

        status.timestampMs = millis();

        if (changed)
        {
            ++status.sequence;
        }
    }

    // ------------------------------------------------------
    // Set normal state
    // ------------------------------------------------------

    void setNormal()
    {
        status.fault = FaultCode::None;
        status.type = EventType::None;
        status.active = false;
    }
}

// ==========================================================
// INITIALIZATION
// ==========================================================

void eventsInit()
{
    status.fault =
        FaultCode::None;

    status.type =
        EventType::None;

    status.active =
        false;

    status.timestampMs =
        0;

    status.sequence =
        0;
}

// ==========================================================
// CLEAR EVENT / RECOVERY
// ==========================================================

void eventsClear()
{
    status.fault =
        FaultCode::None;

    status.type =
        EventType::Recovery;

    status.active =
        false;

    status.timestampMs =
        millis();

    ++status.sequence;
}

// ==========================================================
// PROCESS SYSTEM CONDITIONS
// ==========================================================

void eventsProcess(
    float currentA,
    float measuredRpm,
    float targetRpm,
    bool currentValid,
    bool rpmValid,
    bool emergencyRequest
)
{
    // ------------------------------------------------------
    // Sanitize input values
    // ------------------------------------------------------

    currentA =
        max(0.0f, currentA);

    measuredRpm =
        max(0.0f, measuredRpm);

    // ======================================================
    // 1. EMERGENCY STOP
    // ======================================================

    if (emergencyRequest)
    {
        setEvent(
            FaultCode::EmergencyStop,
            EventType::Emergency
        );

        return;
    }

    // ======================================================
    // 2. CURRENT SENSOR VALIDITY
    // ======================================================

    if (
        targetRpm > MOTOR_MIN_RPM &&
        !currentValid
    )
    {
        setEvent(
            FaultCode::SensorFault,
            EventType::Fault
        );

        return;
    }

    // ======================================================
    // 3. IR RPM SENSOR VALIDITY
    // ======================================================
    //
    // rpmValid must be generated by the RPM/IR module.
    //
    // TRUE  -> valid IR feedback
    // FALSE -> sensor/feedback problem
    //
    // ======================================================

    if (
        targetRpm > MOTOR_MIN_RPM &&
        !rpmValid
    )
    {
        setEvent(
            FaultCode::SensorFault,
            EventType::Fault
        );

        return;
    }

    // ======================================================
    // 4. OVER-CURRENT PROTECTION
    // ======================================================

    if (currentA >= CURRENT_LIMIT_A)
    {
        setEvent(
            FaultCode::OverCurrent,
            EventType::Fault
        );

        return;
    }

    // ======================================================
    // 5. OVER-SPEED PROTECTION
    // ======================================================

    if (measuredRpm >= MAX_SAFE_RPM)
    {
        setEvent(
            FaultCode::OverSpeed,
            EventType::Fault
        );

        return;
    }

    // ======================================================
    // 6. TARGET RANGE VALIDATION
    // ======================================================

    if (
        targetRpm < MOTOR_MIN_RPM ||
        targetRpm > MOTOR_MAX_RPM
    )
    {
        setEvent(
            FaultCode::InvalidCommand,
            EventType::Fault
        );

        return;
    }

    // ======================================================
    // 7. CURRENT WARNING
    // ======================================================

    if (currentA >= CURRENT_WARNING_A)
    {
        setEvent(
            FaultCode::None,
            EventType::Warning
        );

        return;
    }

    // ======================================================
    // 8. NORMAL / RECOVERY
    // ======================================================

    if (status.active)
    {
        eventsClear();
        return;
    }

    setNormal();
}

// ==========================================================
// STATUS
// ==========================================================

EventStatus eventsGetStatus()
{
    return status;
}

FaultCode eventsGetFault()
{
    return status.fault;
}

EventType eventsGetType()
{
    return status.type;
}

// ==========================================================
// ACTIVE FAULT
// ==========================================================
//
// Warning is NOT treated as a blocking fault.
// Fault / Emergency events are blocking.
//

bool eventsHasActiveFault()
{
    return
        status.active &&
        (
            status.type == EventType::Fault ||
            status.type == EventType::Emergency
        );
}

// ==========================================================
// FAULT STRING
// ==========================================================

const char* faultCodeToString(
    FaultCode fault
)
{
    switch (fault)
    {
        case FaultCode::None:
            return "NONE";

        case FaultCode::OverCurrent:
            return "OVER_CURRENT";

        case FaultCode::OverSpeed:
            return "OVER_SPEED";

        case FaultCode::SensorFault:
            return "SENSOR_FAULT";

        case FaultCode::InvalidCommand:
            return "INVALID_COMMAND";

        case FaultCode::EmergencyStop:
            return "EMERGENCY_STOP";
    }

    return "UNKNOWN";
}

// ==========================================================
// EVENT TYPE STRING
// ==========================================================

const char* eventTypeToString(
    EventType type
)
{
    switch (type)
    {
        case EventType::None:
            return "NONE";

        case EventType::Warning:
            return "WARNING";

        case EventType::Fault:
            return "FAULT";

        case EventType::Recovery:
            return "RECOVERY";

        case EventType::Emergency:
            return "EMERGENCY";
    }

    return "UNKNOWN";
}